## sdkconfig.defaults
```kconfig
# ---- 目标芯片 ----
CONFIG_IDF_TARGET="esp32s3"

# ---- Flash ----
CONFIG_ESPTOOLPY_FLASHSIZE_16MB=y
CONFIG_ESPTOOLPY_FLASHSIZE="16MB"
CONFIG_ESPTOOLPY_FLASHMODE_QIO=y

# ---- PSRAM (WROOM-1-N16R8 = 8MB Octal PSRAM) ----
CONFIG_SPIRAM=y
CONFIG_SPIRAM_MODE_OCT=y
CONFIG_SPIRAM_SPEED_80M=y

# ---- 分区表（双 OTA + storage）----
CONFIG_PARTITION_TABLE_CUSTOM=y
CONFIG_PARTITION_TABLE_CUSTOM_FILENAME="partitions.csv"
CONFIG_PARTITION_TABLE_FILENAME="partitions.csv"

# ---- CPU / FreeRTOS ----
CONFIG_ESP_DEFAULT_CPU_FREQ_MHZ_240=y
CONFIG_FREERTOS_HZ=1000
CONFIG_ESP_MAIN_TASK_STACK_SIZE=8192

# ---- HTTP Server ----
CONFIG_HTTPD_WS_SUPPORT=y
CONFIG_HTTPD_MAX_REQ_HDR_LEN=1024
CONFIG_HTTPD_MAX_URI_LEN=512

# ---- WiFi / 网络 ----
CONFIG_ESP_WIFI_STATIC_RX_BUFFER_NUM=4
CONFIG_ESP_WIFI_DYNAMIC_RX_BUFFER_NUM=8
CONFIG_LWIP_MAX_SOCKETS=16

# ---- 项目特有 ----
# 关闭 brownout 检测，避免电机电流尖峰触发复位
CONFIG_ESP_BROWNOUT_DET=n
CONFIG_ESP_SYSTEM_BROWNOUT_INTR=n
```
